## retro-core/main/Kconfig.projbuild
```kconfig
menu "Retro-Go"

choice RG_NES_EMULATOR
    prompt "NES emulator"
    default RG_NES_EMULATOR_NOFRENDO

config RG_NES_EMULATOR_NESTOPIA
    bool "Nestopia"

config RG_NES_EMULATOR_NOFRENDO
    bool "Nofrendo fallback"

endchoice

endmenu
```

## tools/wifi-companion/sdkconfig.defaults.esp32
```kconfig
CONFIG_IDF_TARGET="esp32"
CONFIG_ESPTOOLPY_FLASHSIZE_4MB=y
CONFIG_ESPTOOLPY_FLASHMODE_DIO=y
CONFIG_ESPTOOLPY_FLASHFREQ_40M=y
CONFIG_ESP_SDIO_HOST_INTERFACE=y
CONFIG_ESP_SDIO_DEFAULT_SPEED=y
CONFIG_ESP_SDIO_NSEND_PSAMPLE=y
CONFIG_ESP_SDIO_GPIO_RESET=-1
# CONFIG_BT_ENABLED is not set
# CONFIG_ESP_HOSTED_CP_BT is not set
```
